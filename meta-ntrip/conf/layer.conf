## meta-ntrip/conf/layer.conf
```bitbake
# We have a conf and classes directory, add to BBPATH
BBPATH .= ":${LAYERDIR}"

# We have recipes-* directories, add to BBFILES
BBFILES += "${LAYERDIR}/recipes-*/*/*.bb \
            ${LAYERDIR}/recipes-*/*/*.bbappend"

BBFILE_COLLECTIONS += "../sources/meta-ntrip"
BBFILE_PATTERN_../sources/meta-ntrip = "^${LAYERDIR}/"
BBFILE_PRIORITY_../sources/meta-ntrip = "6"

LAYERSERIES_COMPAT_../sources/meta-ntrip = "sumo thud"
```
